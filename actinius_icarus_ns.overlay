// To get started, press Ctrl+Space to bring up the completion menu and view the available nodes.
// For more help, browse the DeviceTree documentation at https://docs.zephyrproject.org/latest/guides/dts/index.html

/ {
    dht22 {
        compatible = "aosong,dht";
        status = "okay";
        label = "DHT22";
        dio-gpios = <&gpio0 4 (GPIO_PULL_UP | GPIO_ACTIVE_LOW)>;
        dht22;
    };
};

// / {
//     dht {
//         compatible = "aosong,dht";
//         dio-gpios = <&gpio0 4 (GPIO_PULL_UP | GPIO_ACTIVE_LOW)>;
//     };
// };
