## src/lwm2m/Kconfig
```kconfig
#
# Copyright (c) 2021 Nordic Semiconductor ASA
#
# SPDX-License-Identifier: LicenseRef-Nordic-5-Clause
#

config LWM2M_APP_ACCELEROMETER
	bool
	select LWM2M_IPSO_ACCELEROMETER
	select ACCELEROMETER
	help
	  Create LWM2M accelerometer object.
```
